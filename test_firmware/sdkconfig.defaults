## test_firmware/sdkconfig.defaults
```kconfig
# Override some defaults so BT stack is enabled
# and WiFi disabled by default in this example
CONFIG_BT_ENABLED=n
CONFIG_BTDM_CONTROLLER_MODE_BLE_ONLY=n
CONFIG_BTDM_CONTROLLER_MODE_BR_EDR_ONLY=n
CONFIG_BTDM_CONTROLLER_MODE_BTDM=n
CONFIG_CLASSIC_BT_ENABLED=n
CONFIG_WIFI_ENABLED=n
CONFIG_BT_SPP_ENABLED=n
```
